/*
 * gpioc vem com status="disabled" por padrão neste board
 * (dts/arm/nxp/nxp_kl25z.dtsi) — só gpioa/b/d são habilitados pelo
 * frdm_kl25z.dts. Motor L (IN1/IN2) usa PTC8/PTC9, então precisa
 * ligar aqui (mesmo motivo do overlay em ../../../Exp2_PSI3422/Carrinho).
 * gpiod (encoders, PTD1/PTD3) já é default, não precisa de overlay.
 */
&gpioc {
	status = "okay";
};

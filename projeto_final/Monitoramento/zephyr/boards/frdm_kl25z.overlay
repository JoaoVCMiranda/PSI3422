/*
 * gpioc e gpioe vêm com status="disabled" por padrão neste board
 * (dts/arm/nxp/nxp_kl25z.dtsi) — só gpioa/b/d são habilitados pelo
 * frdm_kl25z.dts. O monitoramento usa PTC (CSN/SCK/MOSI/MISO do
 * rádio, mesmo pinmap de Carrinho/Controle), então precisa ser
 * ligado aqui. gpioe é ligado por consistência com os outros dois
 * overlays (ver Carrinho/Controle) — mesmo pinmap compartilhado.
 *
 * Este arquivo é auto-descoberto pelo boilerplate.cmake do Zephyr
 * porque está em zephyr/boards/ (dentro do APPLICATION_SOURCE_DIR
 * usado pelo CMake, que é zephyr/, não a raiz do projeto PlatformIO)
 * — não precisa de nenhuma opção em platformio.ini.
 *
 * SPI não aparece aqui porque não tem nó de devicetree neste port
 * (ver comentário no topo de src/main.c) — spi.c acessa os
 * registradores direto via CMSIS, sem passar pela devicetree.
 */
&gpioc {
	status = "okay";
};

&gpioe {
	status = "okay";
};
